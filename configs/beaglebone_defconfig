## configs/beaglebone_defconfig
```kconfig
# architecture
BR2_arm=y
BR2_cortex_a8=y
BR2_ARM_SOFT_FLOAT=y
BR2_ARM_INSTRUCTIONS_THUMB2=y

# lock down headers to avoid breaking with new defaults
BR2_KERNEL_HEADERS_VERSION=y
BR2_DEFAULT_KERNEL_VERSION="3.8.13"

# toolchain
BR2_TOOLCHAIN_BUILDROOT_LARGEFILE=y
BR2_TOOLCHAIN_BUILDROOT_INET_IPV6=y
BR2_TOOLCHAIN_BUILDROOT_WCHAR=y
BR2_BINUTILS_VERSION_2_22=y
BR2_TOOLCHAIN_BUILDROOT_CXX=y

# system
BR2_TARGET_GENERIC_HOSTNAME="beaglebone"
BR2_TARGET_GENERIC_GETTY_PORT="ttyO0"
# BR2_TARGET_GENERIC_REMOUNT_ROOTFS_RW is not set

# kernel
BR2_LINUX_KERNEL=y
BR2_LINUX_KERNEL_CUSTOM_GIT=y
BR2_LINUX_KERNEL_CUSTOM_GIT_REPO_URL="git://github.com/beagleboard/linux.git"
BR2_LINUX_KERNEL_CUSTOM_GIT_VERSION="ccf1227a616319f2d244501e026b8bf9ce8868ba"
BR2_LINUX_KERNEL_USE_CUSTOM_CONFIG=y
BR2_LINUX_KERNEL_CUSTOM_CONFIG_FILE="board/beaglebone/linux.config"
BR2_LINUX_KERNEL_DTS_SUPPORT=y
BR2_LINUX_KERNEL_USE_INTREE_DTS=y
BR2_LINUX_KERNEL_INTREE_DTS_NAME="am335x-bone am335x-boneblack"

# packages
BR2_PACKAGE_I2C_TOOLS=y
BR2_PACKAGE_NODEJS=y
BR2_PACKAGE_NODEJS_NPM=y
BR2_PACKAGE_NODEJS_MODULES_ADDITIONAL="bonescript"
BR2_PACKAGE_LIBICONV=y
BR2_PACKAGE_UTIL_LINUX=y
BR2_PACKAGE_UTIL_LINUX_LIBBLKID=y
BR2_PACKAGE_UTIL_LINUX_MOUNT=y
BR2_PACKAGE_UTIL_LINUX_PARTX=y

# filesystem
BR2_TARGET_ROOTFS_CPIO_GZIP=y
BR2_TARGET_ROOTFS_INITRAMFS=y
# BR2_TARGET_ROOTFS_TAR is not set

# bootloader
BR2_TARGET_UBOOT=y
BR2_TARGET_UBOOT_BOARDNAME="am335x_evm"
BR2_TARGET_UBOOT_CUSTOM_VERSION=y
BR2_TARGET_UBOOT_CUSTOM_VERSION_VALUE="2013.07"
BR2_TARGET_UBOOT_FORMAT_IMG=y
BR2_TARGET_UBOOT_SPL=y
BR2_TARGET_UBOOT_SPL_NAME="MLO"

# host tools
BR2_PACKAGE_HOST_E2FSPROGS=y
BR2_PACKAGE_HOST_GENEXT2FS=y
BR2_PACKAGE_HOST_UBOOT_TOOLS=y
```

## configs/pocketbeagle_defconfig
```kconfig
# arch
BR2_arm=y
BR2_cortex_a8=y

BR2_GLOBAL_PATCH_DIR="board/beaglebone/patches"

# headers 4.14
BR2_PACKAGE_HOST_LINUX_HEADERS_CUSTOM_4_14=y

BR2_TARGET_GENERIC_GETTY_PORT="ttyO0"
BR2_ROOTFS_POST_IMAGE_SCRIPT="board/pocketbeagle/post-image.sh"

# kernel 4.14
BR2_LINUX_KERNEL=y
BR2_LINUX_KERNEL_CUSTOM_VERSION=y
BR2_LINUX_KERNEL_CUSTOM_VERSION_VALUE="4.14"
BR2_LINUX_KERNEL_PATCH="board/pocketbeagle/patches/linux"
BR2_LINUX_KERNEL_DEFCONFIG="omap2plus"
BR2_LINUX_KERNEL_DTS_SUPPORT=y
BR2_LINUX_KERNEL_INTREE_DTS_NAME="am335x-pocketbeagle"

# filesystem / image
BR2_TARGET_ROOTFS_EXT2=y
BR2_TARGET_ROOTFS_EXT2_4=y

# bootloader
BR2_TARGET_UBOOT=y
BR2_TARGET_UBOOT_BUILD_SYSTEM_KCONFIG=y
BR2_TARGET_UBOOT_CUSTOM_VERSION=y
BR2_TARGET_UBOOT_CUSTOM_VERSION_VALUE="2018.01"
BR2_TARGET_UBOOT_PATCH="board/pocketbeagle/patches/u-boot"
BR2_TARGET_UBOOT_BOARD_DEFCONFIG="am335x_pocketbeagle"
BR2_TARGET_UBOOT_NEEDS_DTC=y
# BR2_TARGET_UBOOT_FORMAT_BIN is not set
BR2_TARGET_UBOOT_FORMAT_IMG=y
BR2_TARGET_UBOOT_FORMAT_CUSTOM=y
BR2_TARGET_UBOOT_FORMAT_CUSTOM_NAME="spl/u-boot-spl.bin"
BR2_TARGET_UBOOT_SPL=y
BR2_TARGET_UBOOT_SPL_NAME="MLO"

# required tools to create the eMMC image
BR2_PACKAGE_HOST_DOSFSTOOLS=y
BR2_PACKAGE_HOST_GENIMAGE=y
BR2_PACKAGE_HOST_MTOOLS=y
```

## package/autorun/Config.in
```kconfig
config BR2_PACKAGE_AUTORUN
	bool "autorun"
	help
	  Simple init.d script to run /dev/mmcblk0p1/autorun.sh
```

## package/beaglesnes/Config.in
```kconfig
config BR2_PACKAGE_BEAGLESNES
	bool "BeagleSNES"
	select BR2_PACKAGE_SDL
	select BR2_PACKAGE_SDL_TTF
	select BR2_PACKAGE_SDL_IMAGE
	select BR2_PACKAGE_SDL_MEDIA
	help
	  BeagleSNES is a Super Nintendo emulator customized for BeagleBoard-xM
	  and BeagleBone Black. It is a fork of SNES9X-SDL, v1.53.

	  See http://www.beaglesnes.org for more details.
```
